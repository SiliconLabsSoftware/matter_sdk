## examples/generator-firmware/silabs/zephyr/boards/xg24_gfw/board.yml
```yaml
board:
    name: xg24_gfw
    full_name: Matter xG24/MGM24 Provisioning GFW
    vendor: silabs
    socs:
        - name: efr32mg24b010f1024im48
```

## examples/generator-firmware/silabs/zephyr/boards/xg26_gfw/board.yml
```yaml
board:
    name: xg26_gfw
    full_name: Matter xG26/MGM26 Provisioning GFW
    vendor: silabs
    socs:
        - name: efr32mg26b211f2048im68
```
